## conf/layer.conf
```bitbake
# We have a conf and classes directory, add to BBPATH
BBPATH .= ":${LAYERDIR}"

# We have recipes-* directories, add to BBFILES
BBFILES += "${LAYERDIR}/recipes-*/*/*.bb \
            ${LAYERDIR}/recipes-*/*/*.bbappend"

BBFILE_COLLECTIONS += "meta-luckfox-pico"
BBFILE_PATTERN_meta-luckfox-pico = "^${LAYERDIR}/"
BBFILE_PRIORITY_meta-luckfox-pico = "6"

LAYERDEPENDS_meta-luckfox-pico = "core"
LAYERSERIES_COMPAT_meta-luckfox-pico = "scarthgap"
```

## conf/machine/include/rv1106.inc
```bitbake
require conf/machine/include/arm/armv7a/tune-cortexa7.inc

PREFERRED_PROVIDER_virtual/bootloader ?= "u-boot-rockchip"

PREFERRED_PROVIDER_virtual/kernel ?= "linux-rockchip"

KERNEL_IMAGETYPE ?= "Image"

SERIAL_CONSOLES ?= "115200;ttyFIQ0"

USE_VT = "0"
```

## conf/machine/luckfox-pico-max.conf
```bitbake
require conf/machine/include/rv1106.inc

UBOOT_MACHINE = "rv1106_defconfig"

KERNEL_DEVICETREE ?= "rv1106g-luckfox-pico-max.dtb"

RK_ENV_PART ?= "8K@24K(env),256K@32K(idblock),512K(uboot),16M@1M(boot),1G@17M(rootfs)"
#TODO: RK_ENV_SIZE should be calculated in u-boot-rockchip.bb
RK_ENV_SIZE ?= "0x2000"
```
